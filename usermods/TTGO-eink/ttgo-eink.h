
/*
 * This file allows you to add own functionality to WLED more easily
 * See: https://github.com/Aircoookie/WLED/wiki/Add-own-functionality
 * EEPROM bytes 2750+ are reserved for your custom use case. (if you extend #define EEPSIZE in const.h)
 * bytes 2400+ are currently ununsed, but might be used for future wled features
 */

/*
 * Pin 2 of the TTGO T-Display serves as the data line for the LED string.
 * Pin 35 is set up as the button pin in the platformio_overrides.ini file.
 * The button can be set up via the macros section in the web interface.
 * I use the button to cycle between presets.
 * The Pin 35 button is the one on the RIGHT side of the USB-C port on the board,
 * when the port is oriented downwards.  See readme.md file for photo.
 * The display is set up to turn off after 5 minutes, and turns on automatically 
 * when a change in the dipslayed info is detected (within a 5 second interval).
 */
 
#pragma once
#include <wled.h>
//Use userVar0 and userVar1 (API calls &U0=,&U1=, uint16_t)
//#include "SD.h"
#include "SPI.h"
#include <GxEPD2.h>
 //#include <GxIO/GxIO_SPI/GxIO_SPI.h>
 //#include <GxIO/GxIO.h>
#include <GxEPD2_BW.h>
// #include <GxGDEW027W3/GxGDEW027W3.h>    // 2.7" b/w
// #include <GxGDEW027C44/GxGDEW027C44.h>    // 2.7" b/w/r  

// FreeFonts from Adafruit_GFX
#include <Fonts/FreeMonoBold9pt7b.h>
#include <Fonts/FreeMono9pt7b.h>
#include <Fonts/FreeMonoBold18pt7b.h>
#include <Fonts/FreeMonoBold24pt7b.h>

int bmpWidth = 230, bmpHeight = 60;
//width:230,height:60
const unsigned char lilygo[] = {0x00, 0x00, 0x00, 0x00, 0x00, 0x00, 0x00, 0x00, 0x00, 0x00, 0x00, 0x00, 0x00,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 0x00, 0x00};

#if defined(_GxGDEW0154Z04_H_) || defined(_GxGDEW0213Z16_H_) || defined(_GxGDEW029Z10_H_) || defined(_GxGDEW027C44_H_)
#define HAS_RED_COLOR
#endif

#if defined(_GxGDEW027C44_H_)
const char *skuNum = "SKU:H220";
int startX = 30, startY = 50;
#elif defined(_GxGDEW027W3_H_)
const char *skuNum = "SKU:H225";
int startX = 30, startY = 50;
#endif

#define SPI_MOSI        23
#define SPI_MISO        -1
#define SPI_CLK         18

#define ELINK_SS        5
#define ELINK_BUSY      4
#define ELINK_RESET     16
#define ELINK_DC        17

#define SDCARD_SS       13
#define SDCARD_CLK      14
#define SDCARD_MOSI     15
#define SDCARD_MISO     2

#define BUTTON_1        37
#define BUTTON_2        38
#define BUTTON_3        39

#define IIS_BCK         26
#define IIS_WS          25
#define IIS_DOUT        19

#define ICS43434
#define ICS_IIS_WS      33
#define ICS_IIS_BCK     32
#define ICS_IIS_DIN     27
#define ENABLE_GxEPD2_GFX 1
//GxIO_Class io(SPI, ELINK_SS, ELINK_DC, ELINK_RESET);
//GxEPD_Class display(io, ELINK_RESET, ELINK_BUSY);
//SPIClass sdSPI(VSPI);
GxEPD2_BW<GxEPD2_270, GxEPD2_270::HEIGHT> display(GxEPD2_270(/*CS=5*/ ELINK_SS, /*DC=*/ ELINK_DC, /*RST=*/ ELINK_RESET, /*BUSY=*/ ELINK_BUSY));
//GxEPD2_BW<GxEPD2_270, GxEPD2_270::HEIGHT> display(GxEPD2_270(/*CS=*/ 15, /*DC=*/ 27, /*RST=*/ 26, /*BUSY=*/ 25)); // waveshare esp board? https://github.com/ZinggJM/GxEPD2/blob/master/examples/GxEPD2_WS_ESP32_Driver/GxEPD2_WS_ESP32_Driver.ino
//#include "wled.h"
// #include <TFT_eSPI.h>
// #include <SPI.h>
#include "WiFi.h"
//#include <Wire.h>
//#include "TTGO-eink_menu.h"
// #ifndef TFT_DISPOFF
// #define TFT_DISPOFF 0x28
// #endif

// #ifndef TFT_SLPIN
// #define TFT_SLPIN   0x10
// #endif

// #define TFT_MOSI            19
// #define TFT_SCLK            18
// #define TFT_CS              5
// #define TFT_DC              16
// #define TFT_RST             23

// #define TFT_BL          4  // Display backlight control pin
// #define ADC_EN          14  // Used for enabling battery voltage measurements - not used in this program

// TFT_eSPI display = TFT_eSPI(135, 240); // Invoke custom library
class ttgo_eink : public Usermod 
{
private:  
//bool sdOK = false;
public:

    virtual void setup(void)
    {
//gets called once at boot. Do all initialization that doesn't depend on network here

    /// pinMode(BUTTON_1, INPUT);
    // pinMode(BUTTON_2, INPUT);
    // pinMode(BUTTON_3, INPUT);

    //Serial.begin(115200);

    SPI.begin(SPI_CLK, SPI_MISO, SPI_MOSI, ELINK_SS);
    display.init(); // enable diagnostic output on Serial
    display.setRotation(1);
    display.fillScreen(GxEPD_WHITE);
    display.setTextColor(GxEPD_BLACK);
    display.setFont(&FreeMono9pt7b);
    display.setCursor(0, 0);

    // sdSPI.begin(SDCARD_CLK, SDCARD_MISO, SDCARD_MOSI, SDCARD_SS);
    // if (!SD.begin(SDCARD_SS, sdSPI)) {
    //     sdOK = false;
    // } else {
    //     sdOK = true;
    // }
#if defined(HAS_RED_COLOR)
    display.drawBitmap(lilygo, startX, startY,  bmpWidth, bmpHeight, GxEPD_RED);
#elif defined(_GxGDEW027W3_H_)
    display.drawBitmap(lilygo, startX, startY,  bmpWidth, bmpHeight, GxEPD_WHITE);
#endif

    display.setCursor(display.width()  - display.width() / 2 - 20, display.height() - 35);

#if defined(HAS_RED_COLOR)
    display.setTextColor(GxEPD_RED);
#endif
   // display.println(skuNum);

    display.setTextColor(GxEPD_BLACK);

    display.setCursor(display.width()   / 2 - 60, display.height() - 10);

    // if (sdOK) {
    //     uint32_t cardSize = SD.cardSize() / (1024 * 1024);
    //     display.println("SDCard:" + String(cardSize) + "MB");
    // } else {
    //     display.println("SDCard  None");
    // }
    display.nextPage();
   // setupMenu();
    
    // Serial.begin(115200);
    // Serial.println("Start");
    // display.init();
    // display.setRotation(3);  //Rotation here is set up for the text to be readable with the port on the left. Use 1 to flip.
    // display.fillScreen(TFT_BLACK);
    // display.setTextSize(2);
    // display.setTextColor(TFT_WHITE);
    // display.setCursor(1, 10);
    // display.setTextDatum(MC_DATUM);
    // display.setTextSize(3);
    // display.print("Loading...");

    // if (TFT_BL > 0) { // TFT_BL has been set in the TFT_eSPI library in the User Setup file TTGO_T_Display.h
    //      pinMode(TFT_BL, OUTPUT); // Set backlight pin to output mode
    //      digitalWrite(TFT_BL, HIGH); // Turn backlight on. 
    // }

    // display.setRotation(3);
}

// gets called every time WiFi is (re-)connected. Initialize own network
// interfaces here
void userConnected() {}

// needRedraw marks if redraw is required to prevent often redrawing.
bool needRedraw = true;

// Next variables hold the previous known values to determine if redraw is
// required.
String knownSsid = "";
IPAddress knownIp;
uint8_t knownBrightness = 0;
uint8_t knownMode = 0;
uint8_t knownPalette = 0;
uint8_t displaycharwidth = 19;  // Number of chars that fit on screen with text size set to 2

long lastUpdate = 0;
long lastRedraw = 0;
bool displayTurnedOff = false;
// How often we are redrawing screen
#define USER_LOOP_REFRESH_RATE_MS 5000

void loop(void) {
// taskManager.runLoop();
  // Check if we time interval for redrawing passes.
  if (millis() - lastUpdate < USER_LOOP_REFRESH_RATE_MS) {
    return;
  }
  lastUpdate = millis();
  
  // Turn off display after 5 minutes with no change.
  //  if(!displayTurnedOff && millis() - lastRedraw > 5*60*1000) {
  //   digitalWrite(TFT_BL, LOW); // Turn backlight off. 
  //   displayTurnedOff = true;
  // } 

  // Check if values which are shown on display changed from the last time.
  if (((apActive) ? String(apSSID) : WiFi.SSID()) != knownSsid) {
    needRedraw = true;
  } else if (knownIp != (apActive ? IPAddress(4, 3, 2, 1) : WiFi.localIP())) {
    needRedraw = true;
  } else if (knownBrightness != bri) {
    needRedraw = true;
  // } else if (knownMode != strip..getMode()) {
  //   needRedraw = true;
  } else if (knownPalette != strip.getSegment(0).palette) {
    needRedraw = true;
  }

  if (!needRedraw) {
    return;
  }
  needRedraw = false;
  
  // if (displayTurnedOff)
  // {
  //   digitalWrite(TFT_BL, TFT_BACKLIGHT_ON); // Turn backlight on.
  //   displayTurnedOff = false;
  // }
  lastRedraw = millis();

  // Update last known values.
  #if defined(ESP8266)
  knownSsid = apActive ? WiFi.softAPSSID() : WiFi.SSID();
  #else
  knownSsid = WiFi.SSID();
  #endif
  knownIp = apActive ? IPAddress(4, 3, 2, 1) : WiFi.localIP();
  knownBrightness = bri;
  // knownMode = strip.getMode();
  knownPalette = strip.getSegment(0).palette;

  display.fillScreen(GxEPD_WHITE);
  //display.setTextSize(2);
  // First row with Wifi name
  display.setCursor(0,0);
  display.print(knownSsid.substring(0, displaycharwidth > 1 ? displaycharwidth - 1 : 0));
  // Print `~` char to indicate that SSID is longer, than our dicplay
  if (knownSsid.length() > displaycharwidth)
    display.print("~");

  // Second row with AP IP and Password or IP
  //display.setTextSize(2);
  display.setCursor(1, 24);
  // Print AP IP and password in AP mode or knownIP if AP not active.
  // if (apActive && bri == 0)
  //   display.print(apPass);
  // else
  //   display.print(knownIp);

  if (apActive) {
    display.print("AP IP: ");
    display.print(knownIp);
    display.setCursor(1,46);
    display.print("AP Pass:");
    display.print(apPass);
  }
  else {
    display.print("IP:");
    display.println(knownIp);
    //display.setCursor(1,46);
    //display.print("Signal Strength: ");
    //display.print(i.wifi.signal);
    display.print("Brt: ");
    display.print(((float(bri)/255)*100));
    display.println("%");
  }

  // Third row with mode name
  //display.setCursor(1, 68);
  uint8_t qComma = 0;
  bool insideQuotes = false;
  uint8_t printedChars = 0;
  char singleJsonSymbol;
  // Find the mode name in JSON
  for (size_t i = 0; i < strlen_P(JSON_mode_names); i++) {
    singleJsonSymbol = pgm_read_byte_near(JSON_mode_names + i);
    switch (singleJsonSymbol) {
    case '"':
      insideQuotes = !insideQuotes;
      break;
    case '[':
    case ']':
      break;
    case ',':
      qComma++;
    default:
      if (!insideQuotes || (qComma != knownMode))
        break;
      display.print(singleJsonSymbol);
      printedChars++;
    }
    if ((qComma > knownMode) || (printedChars > displaycharwidth - 1))
      break;
  }
  // Fourth row with palette name
 // display.setCursor(1, 90);
 display.println();
  qComma = 0;
  insideQuotes = false;
  printedChars = 0;
  // Looking for palette name in JSON.
  for (size_t i = 0; i < strlen_P(JSON_palette_names); i++) {
    singleJsonSymbol = pgm_read_byte_near(JSON_palette_names + i);
    switch (singleJsonSymbol) {
    case '"':
      insideQuotes = !insideQuotes;
      break;
    case '[':
    case ']':
      break;
    case ',':
      qComma++;
    default:
      if (!insideQuotes || (qComma != knownPalette))
        break;
      display.print(singleJsonSymbol);
      printedChars++;
    }
    // The following is modified from the code from the u8g2/u8g8 based code (knownPalette was knownMode)
    if ((qComma > knownPalette) || (printedChars > displaycharwidth - 1))
      break;
  }
  display.println();
  // Fifth row with estimated mA usage
  //display.setCursor(1, 112);
  // Print estimated milliamp usage (must specify the LED type in LED prefs for this to be a reasonable estimate).
  display.print(strip.currentMilliamps);
  display.print("mA");
  //display.update();
  display.nextPage();
}};
